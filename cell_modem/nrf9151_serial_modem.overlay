/*
 * AT interface UART. Board defaults (fork commit 268e839) are:
 *   uart0  P0.11/P0.10  RP2040 USB bridge   115200   <- ncs,sm-uart
 *   uart1  P0.24/P0.23  Feather TX/RX pins  1000000  <- zephyr,console + shell
 *
 * If the zephyr,console UART is set (even if unused!) serial-modem firmware
 * suspends it at startup with INIT ERROR on failure. So the zephyr,console
 * UART must never be the same as the ncs,sm-uart (AT command) UART.
 */
/ {
	chosen {
		ncs,sm-uart = &uart1;
		zephyr,console = &uart0;
	};
};

&uart1 {
	status = "okay";  /* ensure port is enabled */
	current-speed = <115200>;  /* runs at 1 Mbaud by default */
};
