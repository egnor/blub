/*
 * Move the Serial Modem AT interface from uart0 (the RP2040 USB bridge,
 * TX P0.11 / RX P0.10) to uart1, whose pins are the Feather header TX/RX
 * (TX P0.24 / RX P0.23). Build-time choice: with this overlay the AT
 * interface is ONLY on the header pins; uart0 keeps the Zephyr console,
 * so the boot banner and logs still appear on USB.
 *
 * Usage (from the app dir; $BLUB = this repo's root):
 *   EXTRA_DTC_OVERLAY_FILE=$BLUB/cell_modem/at-header-uart.overlay west build -p
 */

/ {
	chosen {
		ncs,sm-uart = &uart1;
	};
};

&uart1 {
	status = "okay";
	/* The board file sets 1 Mbaud for modem tracing (unused here). */
	current-speed = <115200>;
};
